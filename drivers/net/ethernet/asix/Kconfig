## drivers/net/ethernet/asix/Kconfig
```kconfig
#
# Alteon network device configuration
#
config AX88796B
	tristate "ASIX AX88796B NE2000 clone support"
	depends on ARM || MIPS || SUPERH
	select CRC32
	select MII
	help
	  AX88796B driver, using platform bus to provide
	  chip detection and resources
```
